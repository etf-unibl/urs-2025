## lab-08/buildroot/package/canopen/Config.in
```kconfig
config BR2_PACKAGE_CANOPEN
	bool "canopen"
	help
	  This software is CANopenNode implementation on
	  Linux devices

	  https://github.com/CANopenNode/CANopenLinux
```
